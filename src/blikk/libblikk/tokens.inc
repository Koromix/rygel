// SPDX-License-Identifier: GPL-3.0-or-later
// SPDX-FileCopyrightText: 2025 Niels Martignène <niels.martignene@protonmail.com>

#if !defined(TOKEN)
    #error Please define TOKEN() before including tokens.inc
#endif

// Keywords
TOKEN(Func, "func")
TOKEN(Return, "return")
TOKEN(Let, "let")
TOKEN(Mut, "mut")
TOKEN(Begin, "begin")
TOKEN(End, "end")
TOKEN(If, "if")
TOKEN(Else, "else")
TOKEN(While, "while")
TOKEN(For, "for")
TOKEN(In, "in")
TOKEN(Break, "break")
TOKEN(Continue, "continue")
TOKEN(Do, "do")
TOKEN(Record, "record")
TOKEN(Enum, "enum")
TOKEN(Pass, "pass")

// Immediate values
TOKEN(Null, "null")
TOKEN(Boolean, "<bool>")
TOKEN(Integer, "<integer>")
TOKEN(Float, "<float>")
TOKEN(String, "<string>")
TOKEN(Identifier, "<identifier>")

// Operators
TOKEN(Dot, ".")
TOKEN(Colon, ":")
TOKEN(LeftParenthesis, "(")
TOKEN(RightParenthesis, ")")
TOKEN(LeftBracket, "[")
TOKEN(RightBracket, "]")
TOKEN(Plus, "+")
TOKEN(Minus, "-")
TOKEN(Multiply, "*")
TOKEN(Divide, "/")
TOKEN(Modulo, "%")
TOKEN(And, "&")
TOKEN(Or, "|")
TOKEN(XorOrComplement, "~")
TOKEN(LeftShift, "<<")
TOKEN(RightShift, ">>")
TOKEN(LeftRotate, "<<<")
TOKEN(RightRotate, ">>>")
TOKEN(AndAnd, "and")
TOKEN(OrOr, "or")
TOKEN(Not, "not")
TOKEN(Equal, "=")
TOKEN(Reassign, ":=")
TOKEN(PlusAssign, "+=")
TOKEN(MinusAssign, "-=")
TOKEN(MultiplyAssign, "*=")
TOKEN(DivideAssign, "/=")
TOKEN(ModuloAssign, "%=")
TOKEN(LeftShiftAssign, "<<=")
TOKEN(RightShiftAssign, ">>=")
TOKEN(LeftRotateAssign, "<<<=")
TOKEN(RightRotateAssign, ">>>=")
TOKEN(AndAssign, "&=")
TOKEN(OrAssign, "|=")
TOKEN(XorAssign, "~=")
TOKEN(NotEqual, "!=")
TOKEN(Greater, ">")
TOKEN(GreaterOrEqual, ">=")
TOKEN(Less, "<")
TOKEN(LessOrEqual, "<=")
TOKEN(Comma, ",")

// End statements
TOKEN(EndOfLine, "<end of line>")
TOKEN(Semicolon, ";")

#undef TOKEN
