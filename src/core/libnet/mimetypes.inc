// This program is free software: you can redistribute it and/or modify
// it under the terms of the GNU Affero General Public License as published by
// the Free Software Foundation, either version 3 of the License, or
// (at your option) any later version.
//
// This program is distributed in the hope that it will be useful,
// but WITHOUT ANY WARRANTY; without even the implied warranty of
// MERCHANTABILITY or FITNESS FOR A PARTICULAR PURPOSE.  See the
// GNU Affero General Public License for more details.
//
// You should have received a copy of the GNU Affero General Public License
// along with this program. If not, see <https://www.gnu.org/licenses/>.

// Stolen from https://github.com/samuelneff/MimeTypeMap/blob/master/MimeTypeMap.cs
// Thanks!

#ifndef MIMETYPE
    #error Please define MIMETYPE() before including mimetypes.inc
#endif

MIMETYPE(".323", "text/h323")
MIMETYPE(".3g2", "video/3gpp2")
MIMETYPE(".3gp", "video/3gpp")
MIMETYPE(".3gp2", "video/3gpp2")
MIMETYPE(".3gpp", "video/3gpp")
MIMETYPE(".7z", "application/x-7z-compressed")
MIMETYPE(".aa", "audio/audible")
MIMETYPE(".AAC", "audio/aac")
MIMETYPE(".aaf", "application/octet-stream")
MIMETYPE(".aax", "audio/vnd.audible.aax")
MIMETYPE(".ac3", "audio/ac3")
MIMETYPE(".aca", "application/octet-stream")
MIMETYPE(".accda", "application/msaccess.addin")
MIMETYPE(".accdb", "application/msaccess")
MIMETYPE(".accdc", "application/msaccess.cab")
MIMETYPE(".accde", "application/msaccess")
MIMETYPE(".accdr", "application/msaccess.runtime")
MIMETYPE(".accdt", "application/msaccess")
MIMETYPE(".accdw", "application/msaccess.webapplication")
MIMETYPE(".accft", "application/msaccess.ftemplate")
MIMETYPE(".acx", "application/internet-property-stream")
MIMETYPE(".AddIn", "text/xml")
MIMETYPE(".ade", "application/msaccess")
MIMETYPE(".adobebridge", "application/x-bridge-url")
MIMETYPE(".adp", "application/msaccess")
MIMETYPE(".ADT", "audio/vnd.dlna.adts")
MIMETYPE(".ADTS", "audio/aac")
MIMETYPE(".afm", "application/octet-stream")
MIMETYPE(".ai", "application/postscript")
MIMETYPE(".aif", "audio/aiff")
MIMETYPE(".aifc", "audio/aiff")
MIMETYPE(".aiff", "audio/aiff")
MIMETYPE(".air", "application/vnd.adobe.air-application-installer-package+zip")
MIMETYPE(".amc", "application/mpeg")
MIMETYPE(".anx", "application/annodex")
MIMETYPE(".apk", "application/vnd.android.package-archive")
MIMETYPE(".apng", "image/apng")
MIMETYPE(".application", "application/x-ms-application")
MIMETYPE(".art", "image/x-jg")
MIMETYPE(".asa", "application/xml")
MIMETYPE(".asax", "application/xml")
MIMETYPE(".ascx", "application/xml")
MIMETYPE(".asd", "application/octet-stream")
MIMETYPE(".asf", "video/x-ms-asf")
MIMETYPE(".ashx", "application/xml")
MIMETYPE(".asi", "application/octet-stream")
MIMETYPE(".asm", "text/plain")
MIMETYPE(".asmx", "application/xml")
MIMETYPE(".aspx", "application/xml")
MIMETYPE(".asr", "video/x-ms-asf")
MIMETYPE(".asx", "video/x-ms-asf")
MIMETYPE(".atom", "application/atom+xml")
MIMETYPE(".au", "audio/basic")
MIMETYPE(".avci", "image/avci")
MIMETYPE(".avcs", "image/avcs")
MIMETYPE(".avi", "video/x-msvideo")
MIMETYPE(".avif", "image/avif")
MIMETYPE(".avifs", "image/avif-sequence")
MIMETYPE(".axa", "audio/annodex")
MIMETYPE(".axs", "application/olescript")
MIMETYPE(".axv", "video/annodex")
MIMETYPE(".bas", "text/plain")
MIMETYPE(".bcpio", "application/x-bcpio")
MIMETYPE(".bin", "application/octet-stream")
MIMETYPE(".bmp", "image/bmp")
MIMETYPE(".c", "text/plain")
MIMETYPE(".cab", "application/octet-stream")
MIMETYPE(".caf", "audio/x-caf")
MIMETYPE(".calx", "application/vnd.ms-office.calx")
MIMETYPE(".cat", "application/vnd.ms-pki.seccat")
MIMETYPE(".cc", "text/plain")
MIMETYPE(".cd", "text/plain")
MIMETYPE(".cdda", "audio/aiff")
MIMETYPE(".cdf", "application/x-cdf")
MIMETYPE(".cer", "application/x-x509-ca-cert")
MIMETYPE(".cfg", "text/plain")
MIMETYPE(".chm", "application/octet-stream")
MIMETYPE(".class", "application/x-java-applet")
MIMETYPE(".clp", "application/x-msclip")
MIMETYPE(".cmd", "text/plain")
MIMETYPE(".cmx", "image/x-cmx")
MIMETYPE(".cnf", "text/plain")
MIMETYPE(".cod", "image/cis-cod")
MIMETYPE(".config", "application/xml")
MIMETYPE(".contact", "text/x-ms-contact")
MIMETYPE(".coverage", "application/xml")
MIMETYPE(".cpio", "application/x-cpio")
MIMETYPE(".cpp", "text/plain")
MIMETYPE(".crd", "application/x-mscardfile")
MIMETYPE(".crl", "application/pkix-crl")
MIMETYPE(".crt", "application/x-x509-ca-cert")
MIMETYPE(".cs", "text/plain")
MIMETYPE(".csdproj", "text/plain")
MIMETYPE(".csh", "application/x-csh")
MIMETYPE(".csproj", "text/plain")
MIMETYPE(".css", "text/css")
MIMETYPE(".csv", "text/csv")
MIMETYPE(".cur", "application/octet-stream")
MIMETYPE(".czx", "application/x-czx")
MIMETYPE(".cxx", "text/plain")
MIMETYPE(".dat", "application/octet-stream")
MIMETYPE(".datasource", "application/xml")
MIMETYPE(".dbproj", "text/plain")
MIMETYPE(".dcr", "application/x-director")
MIMETYPE(".def", "text/plain")
MIMETYPE(".deploy", "application/octet-stream")
MIMETYPE(".der", "application/x-x509-ca-cert")
MIMETYPE(".dgml", "application/xml")
MIMETYPE(".dib", "image/bmp")
MIMETYPE(".dif", "video/x-dv")
MIMETYPE(".dir", "application/x-director")
MIMETYPE(".disco", "text/xml")
MIMETYPE(".divx", "video/divx")
MIMETYPE(".dll", "application/x-msdownload")
MIMETYPE(".dll.config", "text/xml")
MIMETYPE(".dlm", "text/dlm")
MIMETYPE(".doc", "application/msword")
MIMETYPE(".docm", "application/vnd.ms-word.document.macroEnabled.12")
MIMETYPE(".docx", "application/vnd.openxmlformats-officedocument.wordprocessingml.document")
MIMETYPE(".dot", "application/msword")
MIMETYPE(".dotm", "application/vnd.ms-word.template.macroEnabled.12")
MIMETYPE(".dotx", "application/vnd.openxmlformats-officedocument.wordprocessingml.template")
MIMETYPE(".dsp", "application/octet-stream")
MIMETYPE(".dsw", "text/plain")
MIMETYPE(".dtd", "text/xml")
MIMETYPE(".dtsConfig", "text/xml")
MIMETYPE(".dv", "video/x-dv")
MIMETYPE(".dvi", "application/x-dvi")
MIMETYPE(".dwf", "drawing/x-dwf")
MIMETYPE(".dwg", "application/acad")
MIMETYPE(".dwp", "application/octet-stream")
MIMETYPE(".dxf", "application/x-dxf")
MIMETYPE(".dxr", "application/x-director")
MIMETYPE(".eml", "message/rfc822")
MIMETYPE(".emf", "image/emf")
MIMETYPE(".emz", "application/octet-stream")
MIMETYPE(".eot", "application/vnd.ms-fontobject")
MIMETYPE(".eps", "application/postscript")
MIMETYPE(".es", "application/ecmascript")
MIMETYPE(".etl", "application/etl")
MIMETYPE(".etx", "text/x-setext")
MIMETYPE(".evy", "application/envoy")
MIMETYPE(".exe", "application/vnd.microsoft.portable-executable")
MIMETYPE(".exe.config", "text/xml")
MIMETYPE(".f4v", "video/mp4")
MIMETYPE(".fdf", "application/vnd.fdf")
MIMETYPE(".fif", "application/fractals")
MIMETYPE(".filters", "application/xml")
MIMETYPE(".fla", "application/octet-stream")
MIMETYPE(".flac", "audio/flac")
MIMETYPE(".flr", "x-world/x-vrml")
MIMETYPE(".flv", "video/x-flv")
MIMETYPE(".fsscript", "application/fsharp-script")
MIMETYPE(".fsx", "application/fsharp-script")
MIMETYPE(".generictest", "application/xml")
MIMETYPE(".gif", "image/gif")
MIMETYPE(".gpx", "application/gpx+xml")
MIMETYPE(".group", "text/x-ms-group")
MIMETYPE(".gsm", "audio/x-gsm")
MIMETYPE(".gtar", "application/x-gtar")
MIMETYPE(".gz", "application/x-gzip")
MIMETYPE(".h", "text/plain")
MIMETYPE(".hdf", "application/x-hdf")
MIMETYPE(".hdml", "text/x-hdml")
MIMETYPE(".heic", "image/heic")
MIMETYPE(".heics", "image/heic-sequence")
MIMETYPE(".heif", "image/heif")
MIMETYPE(".heifs", "image/heif-sequence")
MIMETYPE(".hhc", "application/x-oleobject")
MIMETYPE(".hhk", "application/octet-stream")
MIMETYPE(".hhp", "application/octet-stream")
MIMETYPE(".hlp", "application/winhlp")
MIMETYPE(".hpp", "text/plain")
MIMETYPE(".hqx", "application/mac-binhex40")
MIMETYPE(".hta", "application/hta")
MIMETYPE(".htc", "text/x-component")
MIMETYPE(".htm", "text/html")
MIMETYPE(".html", "text/html")
MIMETYPE(".htt", "text/webviewhtml")
MIMETYPE(".hxa", "application/xml")
MIMETYPE(".hxc", "application/xml")
MIMETYPE(".hxd", "application/octet-stream")
MIMETYPE(".hxe", "application/xml")
MIMETYPE(".hxf", "application/xml")
MIMETYPE(".hxh", "application/octet-stream")
MIMETYPE(".hxi", "application/octet-stream")
MIMETYPE(".hxk", "application/xml")
MIMETYPE(".hxq", "application/octet-stream")
MIMETYPE(".hxr", "application/octet-stream")
MIMETYPE(".hxs", "application/octet-stream")
MIMETYPE(".hxt", "text/html")
MIMETYPE(".hxv", "application/xml")
MIMETYPE(".hxw", "application/octet-stream")
MIMETYPE(".hxx", "text/plain")
MIMETYPE(".i", "text/plain")
MIMETYPE(".ical", "text/calendar")
MIMETYPE(".icalendar", "text/calendar")
MIMETYPE(".ico", "image/x-icon")
MIMETYPE(".ics", "text/calendar")
MIMETYPE(".idl", "text/plain")
MIMETYPE(".ief", "image/ief")
MIMETYPE(".ifb", "text/calendar")
MIMETYPE(".iii", "application/x-iphone")
MIMETYPE(".inc", "text/plain")
MIMETYPE(".inf", "application/octet-stream")
MIMETYPE(".ini", "text/plain")
MIMETYPE(".inl", "text/plain")
MIMETYPE(".ins", "application/x-internet-signup")
MIMETYPE(".ipa", "application/x-itunes-ipa")
MIMETYPE(".ipg", "application/x-itunes-ipg")
MIMETYPE(".ipproj", "text/plain")
MIMETYPE(".ipsw", "application/x-itunes-ipsw")
MIMETYPE(".iqy", "text/x-ms-iqy")
MIMETYPE(".isp", "application/x-internet-signup")
MIMETYPE(".isma", "application/octet-stream")
MIMETYPE(".ismv", "application/octet-stream")
MIMETYPE(".ite", "application/x-itunes-ite")
MIMETYPE(".itlp", "application/x-itunes-itlp")
MIMETYPE(".itms", "application/x-itunes-itms")
MIMETYPE(".itpc", "application/x-itunes-itpc")
MIMETYPE(".IVF", "video/x-ivf")
MIMETYPE(".jar", "application/java-archive")
MIMETYPE(".java", "application/octet-stream")
MIMETYPE(".jck", "application/liquidmotion")
MIMETYPE(".jcz", "application/liquidmotion")
MIMETYPE(".jfif", "image/pjpeg")
MIMETYPE(".jnlp", "application/x-java-jnlp-file")
MIMETYPE(".jpb", "application/octet-stream")
MIMETYPE(".jpe", "image/jpeg")
MIMETYPE(".jpeg", "image/jpeg")
MIMETYPE(".jpg", "image/jpeg")
MIMETYPE(".js", "application/javascript")
MIMETYPE(".json", "application/json")
MIMETYPE(".jsx", "text/jscript")
MIMETYPE(".jsxbin", "text/plain")
MIMETYPE(".latex", "application/x-latex")
MIMETYPE(".library-ms", "application/windows-library+xml")
MIMETYPE(".lit", "application/x-ms-reader")
MIMETYPE(".loadtest", "application/xml")
MIMETYPE(".lpk", "application/octet-stream")
MIMETYPE(".lsf", "video/x-la-asf")
MIMETYPE(".lst", "text/plain")
MIMETYPE(".lsx", "video/x-la-asf")
MIMETYPE(".lzh", "application/octet-stream")
MIMETYPE(".m13", "application/x-msmediaview")
MIMETYPE(".m14", "application/x-msmediaview")
MIMETYPE(".m1v", "video/mpeg")
MIMETYPE(".m2t", "video/vnd.dlna.mpeg-tts")
MIMETYPE(".m2ts", "video/vnd.dlna.mpeg-tts")
MIMETYPE(".m2v", "video/mpeg")
MIMETYPE(".m3u", "audio/x-mpegurl")
MIMETYPE(".m3u8", "audio/x-mpegurl")
MIMETYPE(".m4a", "audio/m4a")
MIMETYPE(".m4b", "audio/m4b")
MIMETYPE(".m4p", "audio/m4p")
MIMETYPE(".m4r", "audio/x-m4r")
MIMETYPE(".m4v", "video/x-m4v")
MIMETYPE(".mac", "image/x-macpaint")
MIMETYPE(".mak", "text/plain")
MIMETYPE(".man", "application/x-troff-man")
MIMETYPE(".manifest", "application/x-ms-manifest")
MIMETYPE(".map", "text/plain")
MIMETYPE(".master", "application/xml")
MIMETYPE(".mbox", "application/mbox")
MIMETYPE(".mda", "application/msaccess")
MIMETYPE(".mdb", "application/x-msaccess")
MIMETYPE(".mde", "application/msaccess")
MIMETYPE(".mdp", "application/octet-stream")
MIMETYPE(".me", "application/x-troff-me")
MIMETYPE(".mfp", "application/x-shockwave-flash")
MIMETYPE(".mht", "message/rfc822")
MIMETYPE(".mhtml", "message/rfc822")
MIMETYPE(".mid", "audio/mid")
MIMETYPE(".midi", "audio/mid")
MIMETYPE(".mix", "application/octet-stream")
MIMETYPE(".mk", "text/plain")
MIMETYPE(".mk3d", "video/x-matroska-3d")
MIMETYPE(".mka", "audio/x-matroska")
MIMETYPE(".mkv", "video/x-matroska")
MIMETYPE(".mmf", "application/x-smaf")
MIMETYPE(".mno", "text/xml")
MIMETYPE(".mny", "application/x-msmoney")
MIMETYPE(".mod", "video/mpeg")
MIMETYPE(".mov", "video/quicktime")
MIMETYPE(".movie", "video/x-sgi-movie")
MIMETYPE(".mp2", "video/mpeg")
MIMETYPE(".mp2v", "video/mpeg")
MIMETYPE(".mp3", "audio/mpeg")
MIMETYPE(".mp4", "video/mp4")
MIMETYPE(".mp4v", "video/mp4")
MIMETYPE(".mpa", "video/mpeg")
MIMETYPE(".mpe", "video/mpeg")
MIMETYPE(".mpeg", "video/mpeg")
MIMETYPE(".mpf", "application/vnd.ms-mediapackage")
MIMETYPE(".mpg", "video/mpeg")
MIMETYPE(".mpp", "application/vnd.ms-project")
MIMETYPE(".mpv2", "video/mpeg")
MIMETYPE(".mqv", "video/quicktime")
MIMETYPE(".ms", "application/x-troff-ms")
MIMETYPE(".msg", "application/vnd.ms-outlook")
MIMETYPE(".msi", "application/octet-stream")
MIMETYPE(".mso", "application/octet-stream")
MIMETYPE(".mts", "video/vnd.dlna.mpeg-tts")
MIMETYPE(".mtx", "application/xml")
MIMETYPE(".mvb", "application/x-msmediaview")
MIMETYPE(".mvc", "application/x-miva-compiled")
MIMETYPE(".mxf", "application/mxf")
MIMETYPE(".mxp", "application/x-mmxp")
MIMETYPE(".nc", "application/x-netcdf")
MIMETYPE(".nsc", "video/x-ms-asf")
MIMETYPE(".nws", "message/rfc822")
MIMETYPE(".ocx", "application/octet-stream")
MIMETYPE(".oda", "application/oda")
MIMETYPE(".odb", "application/vnd.oasis.opendocument.database")
MIMETYPE(".odc", "application/vnd.oasis.opendocument.chart")
MIMETYPE(".odf", "application/vnd.oasis.opendocument.formula")
MIMETYPE(".odg", "application/vnd.oasis.opendocument.graphics")
MIMETYPE(".odh", "text/plain")
MIMETYPE(".odi", "application/vnd.oasis.opendocument.image")
MIMETYPE(".odl", "text/plain")
MIMETYPE(".odm", "application/vnd.oasis.opendocument.text-master")
MIMETYPE(".odp", "application/vnd.oasis.opendocument.presentation")
MIMETYPE(".ods", "application/vnd.oasis.opendocument.spreadsheet")
MIMETYPE(".odt", "application/vnd.oasis.opendocument.text")
MIMETYPE(".oga", "audio/ogg")
MIMETYPE(".ogg", "audio/ogg")
MIMETYPE(".ogv", "video/ogg")
MIMETYPE(".ogx", "application/ogg")
MIMETYPE(".one", "application/onenote")
MIMETYPE(".onea", "application/onenote")
MIMETYPE(".onepkg", "application/onenote")
MIMETYPE(".onetmp", "application/onenote")
MIMETYPE(".onetoc", "application/onenote")
MIMETYPE(".onetoc2", "application/onenote")
MIMETYPE(".opus", "audio/ogg")
MIMETYPE(".orderedtest", "application/xml")
MIMETYPE(".osdx", "application/opensearchdescription+xml")
MIMETYPE(".otf", "application/font-sfnt")
MIMETYPE(".otg", "application/vnd.oasis.opendocument.graphics-template")
MIMETYPE(".oth", "application/vnd.oasis.opendocument.text-web")
MIMETYPE(".otp", "application/vnd.oasis.opendocument.presentation-template")
MIMETYPE(".ots", "application/vnd.oasis.opendocument.spreadsheet-template")
MIMETYPE(".ott", "application/vnd.oasis.opendocument.text-template")
MIMETYPE(".oxps", "application/oxps")
MIMETYPE(".oxt", "application/vnd.openofficeorg.extension")
MIMETYPE(".p10", "application/pkcs10")
MIMETYPE(".p12", "application/x-pkcs12")
MIMETYPE(".p7b", "application/x-pkcs7-certificates")
MIMETYPE(".p7c", "application/pkcs7-mime")
MIMETYPE(".p7m", "application/pkcs7-mime")
MIMETYPE(".p7r", "application/x-pkcs7-certreqresp")
MIMETYPE(".p7s", "application/pkcs7-signature")
MIMETYPE(".pbm", "image/x-portable-bitmap")
MIMETYPE(".pcast", "application/x-podcast")
MIMETYPE(".pct", "image/pict")
MIMETYPE(".pcx", "application/octet-stream")
MIMETYPE(".pcz", "application/octet-stream")
MIMETYPE(".pdf", "application/pdf")
MIMETYPE(".pfb", "application/octet-stream")
MIMETYPE(".pfm", "application/octet-stream")
MIMETYPE(".pfx", "application/x-pkcs12")
MIMETYPE(".pgm", "image/x-portable-graymap")
MIMETYPE(".pic", "image/pict")
MIMETYPE(".pict", "image/pict")
MIMETYPE(".pkgdef", "text/plain")
MIMETYPE(".pkgundef", "text/plain")
MIMETYPE(".pko", "application/vnd.ms-pki.pko")
MIMETYPE(".pls", "audio/scpls")
MIMETYPE(".pma", "application/x-perfmon")
MIMETYPE(".pmc", "application/x-perfmon")
MIMETYPE(".pml", "application/x-perfmon")
MIMETYPE(".pmr", "application/x-perfmon")
MIMETYPE(".pmw", "application/x-perfmon")
MIMETYPE(".png", "image/png")
MIMETYPE(".pnm", "image/x-portable-anymap")
MIMETYPE(".pnt", "image/x-macpaint")
MIMETYPE(".pntg", "image/x-macpaint")
MIMETYPE(".pnz", "image/png")
MIMETYPE(".pot", "application/vnd.ms-powerpoint")
MIMETYPE(".potm", "application/vnd.ms-powerpoint.template.macroEnabled.12")
MIMETYPE(".potx", "application/vnd.openxmlformats-officedocument.presentationml.template")
MIMETYPE(".ppa", "application/vnd.ms-powerpoint")
MIMETYPE(".ppam", "application/vnd.ms-powerpoint.addin.macroEnabled.12")
MIMETYPE(".ppm", "image/x-portable-pixmap")
MIMETYPE(".pps", "application/vnd.ms-powerpoint")
MIMETYPE(".ppsm", "application/vnd.ms-powerpoint.slideshow.macroEnabled.12")
MIMETYPE(".ppsx", "application/vnd.openxmlformats-officedocument.presentationml.slideshow")
MIMETYPE(".ppt", "application/vnd.ms-powerpoint")
MIMETYPE(".pptm", "application/vnd.ms-powerpoint.presentation.macroEnabled.12")
MIMETYPE(".pptx", "application/vnd.openxmlformats-officedocument.presentationml.presentation")
MIMETYPE(".prf", "application/pics-rules")
MIMETYPE(".prm", "application/octet-stream")
MIMETYPE(".prx", "application/octet-stream")
MIMETYPE(".ps", "application/postscript")
MIMETYPE(".psc1", "application/PowerShell")
MIMETYPE(".psd", "application/octet-stream")
MIMETYPE(".psess", "application/xml")
MIMETYPE(".psm", "application/octet-stream")
MIMETYPE(".psp", "application/octet-stream")
MIMETYPE(".pst", "application/vnd.ms-outlook")
MIMETYPE(".pub", "application/x-mspublisher")
MIMETYPE(".pwz", "application/vnd.ms-powerpoint")
MIMETYPE(".qht", "text/x-html-insertion")
MIMETYPE(".qhtm", "text/x-html-insertion")
MIMETYPE(".qt", "video/quicktime")
MIMETYPE(".qti", "image/x-quicktime")
MIMETYPE(".qtif", "image/x-quicktime")
MIMETYPE(".qtl", "application/x-quicktimeplayer")
MIMETYPE(".qxd", "application/octet-stream")
MIMETYPE(".ra", "audio/x-pn-realaudio")
MIMETYPE(".ram", "audio/x-pn-realaudio")
MIMETYPE(".rar", "application/x-rar-compressed")
MIMETYPE(".ras", "image/x-cmu-raster")
MIMETYPE(".rat", "application/rat-file")
MIMETYPE(".rc", "text/plain")
MIMETYPE(".rc2", "text/plain")
MIMETYPE(".rct", "text/plain")
MIMETYPE(".rdlc", "application/xml")
MIMETYPE(".reg", "text/plain")
MIMETYPE(".resx", "application/xml")
MIMETYPE(".rf", "image/vnd.rn-realflash")
MIMETYPE(".rgb", "image/x-rgb")
MIMETYPE(".rgs", "text/plain")
MIMETYPE(".rm", "application/vnd.rn-realmedia")
MIMETYPE(".rmi", "audio/mid")
MIMETYPE(".rmp", "application/vnd.rn-rn_music_package")
MIMETYPE(".rmvb", "application/vnd.rn-realmedia-vbr")
MIMETYPE(".roff", "application/x-troff")
MIMETYPE(".rpm", "audio/x-pn-realaudio-plugin")
MIMETYPE(".rqy", "text/x-ms-rqy")
MIMETYPE(".rtf", "application/rtf")
MIMETYPE(".rtx", "text/richtext")
MIMETYPE(".rvt", "application/octet-stream")
MIMETYPE(".ruleset", "application/xml")
MIMETYPE(".s", "text/plain")
MIMETYPE(".safariextz", "application/x-safari-safariextz")
MIMETYPE(".scd", "application/x-msschedule")
MIMETYPE(".scr", "text/plain")
MIMETYPE(".sct", "text/scriptlet")
MIMETYPE(".sd2", "audio/x-sd2")
MIMETYPE(".sdp", "application/sdp")
MIMETYPE(".sea", "application/octet-stream")
MIMETYPE(".searchConnector-ms", "application/windows-search-connector+xml")
MIMETYPE(".setpay", "application/set-payment-initiation")
MIMETYPE(".setreg", "application/set-registration-initiation")
MIMETYPE(".settings", "application/xml")
MIMETYPE(".sgimb", "application/x-sgimb")
MIMETYPE(".sgml", "text/sgml")
MIMETYPE(".sh", "application/x-sh")
MIMETYPE(".shar", "application/x-shar")
MIMETYPE(".shtml", "text/html")
MIMETYPE(".sit", "application/x-stuffit")
MIMETYPE(".sitemap", "application/xml")
MIMETYPE(".skin", "application/xml")
MIMETYPE(".skp", "application/x-koan")
MIMETYPE(".sldm", "application/vnd.ms-powerpoint.slide.macroEnabled.12")
MIMETYPE(".sldx", "application/vnd.openxmlformats-officedocument.presentationml.slide")
MIMETYPE(".slk", "application/vnd.ms-excel")
MIMETYPE(".sln", "text/plain")
MIMETYPE(".slupkg-ms", "application/x-ms-license")
MIMETYPE(".smd", "audio/x-smd")
MIMETYPE(".smi", "application/octet-stream")
MIMETYPE(".smx", "audio/x-smd")
MIMETYPE(".smz", "audio/x-smd")
MIMETYPE(".snd", "audio/basic")
MIMETYPE(".snippet", "application/xml")
MIMETYPE(".snp", "application/octet-stream")
MIMETYPE(".sql", "application/sql")
MIMETYPE(".sol", "text/plain")
MIMETYPE(".sor", "text/plain")
MIMETYPE(".spc", "application/x-pkcs7-certificates")
MIMETYPE(".spl", "application/futuresplash")
MIMETYPE(".spx", "audio/ogg")
MIMETYPE(".src", "application/x-wais-source")
MIMETYPE(".srf", "text/plain")
MIMETYPE(".SSISDeploymentManifest", "text/xml")
MIMETYPE(".ssm", "application/streamingmedia")
MIMETYPE(".sst", "application/vnd.ms-pki.certstore")
MIMETYPE(".stl", "application/vnd.ms-pki.stl")
MIMETYPE(".sv4cpio", "application/x-sv4cpio")
MIMETYPE(".sv4crc", "application/x-sv4crc")
MIMETYPE(".svc", "application/xml")
MIMETYPE(".svg", "image/svg+xml")
MIMETYPE(".swf", "application/x-shockwave-flash")
MIMETYPE(".step", "application/step")
MIMETYPE(".stp", "application/step")
MIMETYPE(".t", "application/x-troff")
MIMETYPE(".tar", "application/x-tar")
MIMETYPE(".tcl", "application/x-tcl")
MIMETYPE(".testrunconfig", "application/xml")
MIMETYPE(".testsettings", "application/xml")
MIMETYPE(".tex", "application/x-tex")
MIMETYPE(".texi", "application/x-texinfo")
MIMETYPE(".texinfo", "application/x-texinfo")
MIMETYPE(".tgz", "application/x-compressed")
MIMETYPE(".thmx", "application/vnd.ms-officetheme")
MIMETYPE(".thn", "application/octet-stream")
MIMETYPE(".tif", "image/tiff")
MIMETYPE(".tiff", "image/tiff")
MIMETYPE(".tlh", "text/plain")
MIMETYPE(".tli", "text/plain")
MIMETYPE(".toc", "application/octet-stream")
MIMETYPE(".tr", "application/x-troff")
MIMETYPE(".trm", "application/x-msterminal")
MIMETYPE(".trx", "application/xml")
MIMETYPE(".ts", "video/vnd.dlna.mpeg-tts")
MIMETYPE(".tsv", "text/tab-separated-values")
MIMETYPE(".ttf", "application/font-sfnt")
MIMETYPE(".tts", "video/vnd.dlna.mpeg-tts")
MIMETYPE(".txt", "text/plain")
MIMETYPE(".u32", "application/octet-stream")
MIMETYPE(".uls", "text/iuls")
MIMETYPE(".user", "text/plain")
MIMETYPE(".ustar", "application/x-ustar")
MIMETYPE(".vb", "text/plain")
MIMETYPE(".vbdproj", "text/plain")
MIMETYPE(".vbk", "video/mpeg")
MIMETYPE(".vbproj", "text/plain")
MIMETYPE(".vbs", "text/vbscript")
MIMETYPE(".vcf", "text/x-vcard")
MIMETYPE(".vcproj", "application/xml")
MIMETYPE(".vcs", "text/plain")
MIMETYPE(".vcxproj", "application/xml")
MIMETYPE(".vddproj", "text/plain")
MIMETYPE(".vdp", "text/plain")
MIMETYPE(".vdproj", "text/plain")
MIMETYPE(".vdx", "application/vnd.ms-visio.viewer")
MIMETYPE(".vml", "text/xml")
MIMETYPE(".vscontent", "application/xml")
MIMETYPE(".vsct", "text/xml")
MIMETYPE(".vsd", "application/vnd.visio")
MIMETYPE(".vsi", "application/ms-vsi")
MIMETYPE(".vsix", "application/vsix")
MIMETYPE(".vsixlangpack", "text/xml")
MIMETYPE(".vsixmanifest", "text/xml")
MIMETYPE(".vsmdi", "application/xml")
MIMETYPE(".vspscc", "text/plain")
MIMETYPE(".vss", "application/vnd.visio")
MIMETYPE(".vsscc", "text/plain")
MIMETYPE(".vssettings", "text/xml")
MIMETYPE(".vssscc", "text/plain")
MIMETYPE(".vst", "application/vnd.visio")
MIMETYPE(".vstemplate", "text/xml")
MIMETYPE(".vsto", "application/x-ms-vsto")
MIMETYPE(".vsw", "application/vnd.visio")
MIMETYPE(".vsx", "application/vnd.visio")
MIMETYPE(".vtt", "text/vtt")
MIMETYPE(".vtx", "application/vnd.visio")
MIMETYPE(".wasm", "application/wasm")
MIMETYPE(".wav", "audio/wav")
MIMETYPE(".wave", "audio/wav")
MIMETYPE(".wax", "audio/x-ms-wax")
MIMETYPE(".wbk", "application/msword")
MIMETYPE(".wbmp", "image/vnd.wap.wbmp")
MIMETYPE(".wcm", "application/vnd.ms-works")
MIMETYPE(".wdb", "application/vnd.ms-works")
MIMETYPE(".wdp", "image/vnd.ms-photo")
MIMETYPE(".webarchive", "application/x-safari-webarchive")
MIMETYPE(".webm", "video/webm")
MIMETYPE(".webp", "image/webp") /* https://en.wikipedia.org/wiki/WebP */
MIMETYPE(".webtest", "application/xml")
MIMETYPE(".wiq", "application/xml")
MIMETYPE(".wiz", "application/msword")
MIMETYPE(".wks", "application/vnd.ms-works")
MIMETYPE(".WLMP", "application/wlmoviemaker")
MIMETYPE(".wlpginstall", "application/x-wlpg-detect")
MIMETYPE(".wlpginstall3", "application/x-wlpg3-detect")
MIMETYPE(".wm", "video/x-ms-wm")
MIMETYPE(".wma", "audio/x-ms-wma")
MIMETYPE(".wmd", "application/x-ms-wmd")
MIMETYPE(".wmf", "application/x-msmetafile")
MIMETYPE(".wml", "text/vnd.wap.wml")
MIMETYPE(".wmlc", "application/vnd.wap.wmlc")
MIMETYPE(".wmls", "text/vnd.wap.wmlscript")
MIMETYPE(".wmlsc", "application/vnd.wap.wmlscriptc")
MIMETYPE(".wmp", "video/x-ms-wmp")
MIMETYPE(".wmv", "video/x-ms-wmv")
MIMETYPE(".wmx", "video/x-ms-wmx")
MIMETYPE(".wmz", "application/x-ms-wmz")
MIMETYPE(".woff", "application/font-woff")
MIMETYPE(".woff2", "application/font-woff2")
MIMETYPE(".wpl", "application/vnd.ms-wpl")
MIMETYPE(".wps", "application/vnd.ms-works")
MIMETYPE(".wri", "application/x-mswrite")
MIMETYPE(".wrl", "x-world/x-vrml")
MIMETYPE(".wrz", "x-world/x-vrml")
MIMETYPE(".wsc", "text/scriptlet")
MIMETYPE(".wsdl", "text/xml")
MIMETYPE(".wvx", "video/x-ms-wvx")
MIMETYPE(".x", "application/directx")
MIMETYPE(".xaf", "x-world/x-vrml")
MIMETYPE(".xaml", "application/xaml+xml")
MIMETYPE(".xap", "application/x-silverlight-app")
MIMETYPE(".xbap", "application/x-ms-xbap")
MIMETYPE(".xbm", "image/x-xbitmap")
MIMETYPE(".xdr", "text/plain")
MIMETYPE(".xht", "application/xhtml+xml")
MIMETYPE(".xhtml", "application/xhtml+xml")
MIMETYPE(".xla", "application/vnd.ms-excel")
MIMETYPE(".xlam", "application/vnd.ms-excel.addin.macroEnabled.12")
MIMETYPE(".xlc", "application/vnd.ms-excel")
MIMETYPE(".xld", "application/vnd.ms-excel")
MIMETYPE(".xlk", "application/vnd.ms-excel")
MIMETYPE(".xll", "application/vnd.ms-excel")
MIMETYPE(".xlm", "application/vnd.ms-excel")
MIMETYPE(".xls", "application/vnd.ms-excel")
MIMETYPE(".xlsb", "application/vnd.ms-excel.sheet.binary.macroEnabled.12")
MIMETYPE(".xlsm", "application/vnd.ms-excel.sheet.macroEnabled.12")
MIMETYPE(".xlsx", "application/vnd.openxmlformats-officedocument.spreadsheetml.sheet")
MIMETYPE(".xlt", "application/vnd.ms-excel")
MIMETYPE(".xltm", "application/vnd.ms-excel.template.macroEnabled.12")
MIMETYPE(".xltx", "application/vnd.openxmlformats-officedocument.spreadsheetml.template")
MIMETYPE(".xlw", "application/vnd.ms-excel")
MIMETYPE(".xml", "text/xml")
MIMETYPE(".xmp", "application/octet-stream")
MIMETYPE(".xmta", "application/xml")
MIMETYPE(".xof", "x-world/x-vrml")
MIMETYPE(".XOML", "text/plain")
MIMETYPE(".xpm", "image/x-xpixmap")
MIMETYPE(".xps", "application/vnd.ms-xpsdocument")
MIMETYPE(".xrm-ms", "text/xml")
MIMETYPE(".xsc", "application/xml")
MIMETYPE(".xsd", "text/xml")
MIMETYPE(".xsf", "text/xml")
MIMETYPE(".xsl", "text/xml")
MIMETYPE(".xslt", "text/xml")
MIMETYPE(".xsn", "application/octet-stream")
MIMETYPE(".xss", "application/xml")
MIMETYPE(".xspf", "application/xspf+xml")
MIMETYPE(".xtp", "application/octet-stream")
MIMETYPE(".xwd", "image/x-xwindowdump")
MIMETYPE(".z", "application/x-compress")
MIMETYPE(".zip", "application/zip")

#undef MIMETYPE
